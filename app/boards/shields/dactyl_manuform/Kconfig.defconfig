## app/boards/shields/dactyl_manuform/Kconfig.defconfig
```kconfig
#Copyright (c) 2020 Derek Schmell
#SPDX-License-Identifier: MIT
 
 
if SHIELD_DACTYL_MANUFORM_LEFT

config ZMK_KEYBOARD_NAME
	default "Dactyl Left"

config ZMK_SPLIT_BLE_ROLE_CENTRAL
	default y

endif

if SHIELD_DACTYL_MANUFORM_RIGHT

config ZMK_KEYBOARD_NAME
	default "Dactyl Right"

config USB
	default y

endif

if SHIELD_DACTYL_MANUFORM_LEFT || SHIELD_DACTYL_MANUFORM_RIGHT

config ZMK_SPLIT
	default y
	
endif
```

## app/boards/shields/dactyl_manuform/Kconfig.shield
```kconfig
# Copyright (c) 2020 Derek Schmell
# SPDX-License-Identifier: MIT

config SHIELD_DACTYL_MANUFORM_LEFT
    def_bool $(shields_list_contains,dactyl_manuform_left)

config SHIELD_DACTYL_MANUFORM_RIGHT
    def_bool $(shields_list_contains,dactyl_manuform_right)
```
